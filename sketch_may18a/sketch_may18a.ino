
String Red(int  L){
  int Te[] = {
    'A', 'B', 'C', 'D',
    'E', 'F', 'G', 'H',
    'I', 'J', 'K', 'L',
    'M', 'N', 'O', 'P',
    'Q', 'R', 'S', 'T',
    'U', 'V', 'W', 'X',
    'Y', 'Z',
    'a', 'b', 'c', 'd',
    'e', 'f', 'g', 'h',
    'i', 'j', 'k', 'l',
    'm', 'n', 'o', 'p',
    'q', 'r', 's', 't',
    'u', 'v', 'w', 'x',
    'y', 'z',
    ',', '.', '!', '\?',
    ';', ':', '(', ')',
    '{', '}', '_', '-',
    '+', '=', '<', '>',
    '/', '\n', '\e', '\r',
    '\t', '\a', '\f', '\v',
    '\b', '\\',
    '1', '2', '3', '4',
    '5', '6', '7', '8',
    '9', '0' 
  };
    String Ou[] = {
    "A", "B", "C", "D",
    "E", "F", "G", "H",
    "I", "J", "K", "L",
    "M", "N", "O", "P",
    "Q", "R", "S", "T",
    "U", "V", "W", "X",
    "Y", "Z",
    "a", "b", "c", "d",
    "e", "f", "g", "h",
    "i", "j", "k", "l",
    "m", "n", "o", "p",
    "q", "r", "s", "t",
    "u", "v", "w", "x",
    "y", "z",
    ",", ".", "!", "\?",
    ";", ":", "(", ")",
    "{", "}", "_", "-",
    "+", "=", "<", ">",
    "/", "\n", "\e", "\r",
    "\t", "\a", "\f", "\v",
    "\b", "\\",
    "1", "2", "3", "4",
    "5", "6", "7", "8",
    "9", "0" 
  };
  for(short int  I = 0; I<88; I++){
    if(L  == Te[I]){
      return Ou[I];
    }
  }

  
}

String R = "";

void setup() {
  Serial.begin(115200);

}

void loop() {
  while(Serial.available() == 0);
  while(Serial.available() > 0){
    R += Red(Serial.read());
  }
  Serial.println(R);
  R = "";

}
